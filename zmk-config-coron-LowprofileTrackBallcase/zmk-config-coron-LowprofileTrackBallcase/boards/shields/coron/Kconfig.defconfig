## zmk-config-coron-LowprofileTrackBallcase/zmk-config-coron-LowprofileTrackBallcase/boards/shields/coron/Kconfig.defconfig
```kconfig
if SHIELD_CORON_R

config ZMK_KEYBOARD_NAME
    default "coron_R"

config ZMK_SPLIT
    default y

config ZMK_SPLIT_ROLE_CENTRAL
    default y

endif

if SHIELD_CORON_L

config ZMK_KEYBOARD_NAME
    default "coron_L"

config ZMK_SPLIT
    default y

endif
```

## zmk-config-coron-LowprofileTrackBallcase/zmk-config-coron-LowprofileTrackBallcase/boards/shields/coron/Kconfig.shield
```kconfig
config SHIELD_CORON_R
    def_bool $(shields_list_contains,coron_R)

config SHIELD_CORON_L
    def_bool $(shields_list_contains,coron_L)
```
